## config/boards/shields/handzilla/Kconfig.defconfig
```kconfig
if SHIELD_HANDZILLA_DONGLE

config ZMK_KEYBOARD_NAME
    default "Handzilla"

config ZMK_SPLIT_ROLE_CENTRAL
    default y

config ZMK_USB
    default y

endif

if SHIELD_HANDZILLA_LEFT || SHIELD_HANDZILLA_RIGHT || SHIELD_HANDZILLA_DONGLE

config ZMK_SPLIT
    default y

config ZMK_BLE
    default y

endif
```

## config/boards/shields/handzilla/Kconfig.shield
```kconfig
config SHIELD_HANDZILLA_LEFT
    def_bool $(shields_list_contains,handzilla_left)

config SHIELD_HANDZILLA_RIGHT
    def_bool $(shields_list_contains,handzilla_right)

config SHIELD_HANDZILLA_DONGLE
    def_bool $(shields_list_contains,handzilla_dongle)
```
